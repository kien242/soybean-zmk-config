## config/boards/arm/soybeans/Kconfig.defconfig
```kconfig
# Copyright (c) 2021 The ZMK Contributors
# SPDX-License-Identifier: MIT

if BOARD_SOYBEANS_V1

config BOARD
	default "Soybeans"

if USB

config USB_NRFX
	default y

config USB_DEVICE_STACK
	default y

endif # USB

if ZMK_DISPLAY

config I2C
	default y

config SSD1306
	default y

config SSD1306_REVERSE_MODE
	default y


config LV_z_VDB_SIZE
	default 64

config LV_Z_DPI
	default 148

config LV_Z_BITS_PER_PIXEL
	default 1

choice LV_COLOR_DEPTH
	default LV_COLOR_DEPTH_1
endchoice

endif # ZMK_DISPLAY

config BT_CTLR
	default BT

config ZMK_BLE
	default y

config ZMK_USB
	default y


config ZMK_KEYBOARD_NAME
	default "Soybeans Rev1"

endif # BOARD_SOYBEANS_V1
```

## config/west.yml
```yaml
manifest:
  remotes:
    - name: zmkfirmware
      url-base: https://github.com/zmkfirmware
    - name : hidergo
      url-base : https://github.com/hidergo
  projects:
    - name: zmk
      remote: hidergo
      revision: boardpilot
      import: app/west.yml
  self:
    path: config
```
